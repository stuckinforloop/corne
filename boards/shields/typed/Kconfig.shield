## boards/shields/typed/Kconfig.shield
```kconfig
config SHIELD_TYPED_LEFT
    def_bool $(shields_list_contains,typed_left)

config SHIELD_TYPED_RIGHT
    def_bool $(shields_list_contains,typed_right)
```
